## config/west.yml
```yaml
manifest:
  remotes:
      # originally kyek / duckyb
    - name: corvijake
      url-base: https://github.com/corvijake
  projects:
    - name: zmk
      remote: corvijake
      revision: main
      import: app/west.yml
    - name: urchin-zmk-module
      remote: corvijake
      revision: main
  self:
    path: config
```
